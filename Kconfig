## Kconfig
```kconfig
# Sensor data simulator
#
# Copyright (c) 2019 Nordic Semiconductor
#
# SPDX-License-Identifier: LicenseRef-Nordic-5-Clause
#

menuconfig PMW3610
  bool "PMW3610 mouse optical sensor"
  select SPI
  depends on INPUT
  depends on DT_HAS_PIXART_PMW3610_ENABLED
  help
      Enable PMW3610 mouse optical sensor.

if PMW3610

config INPUT_PMW3610_INIT_PRIORITY
    int "PMW3610 initialization priority"
    default INPUT_INIT_PRIORITY

config PMW3610_SWAP_XY
  bool "Swap the X/Y axis of PMW3610 sensor"

config PMW3610_INVERT_X
  bool "Invert the X axis of PMW3610 sensor"

config PMW3610_INVERT_Y
  bool "Invert the Y axis of PMW3610 sensor"

config PMW3610_INIT_POWER_UP_EXTRA_DELAY_MS
  int "Extra power up init delay (ms)"
  default 0
  help
    Default minimum init power up delay is 10ms.
    Use this config to postpone init power up sequence if needs longer bootup time.

config PMW3610_REPORT_INTERVAL_MIN
	int "PMW3610's default minimum report rate"
	default 0
	help
	  Default minimum report interval in milliseconds.
		Slow down input reporting for hid queue over the air.
		Turn value down to 8ms to get sharp response if use with USB only.

config PMW3610_SMART_ALGORITHM
  bool "Enable an algorithm of PMW3610 to enhance surface coverage"
  default y
  help
    Enable the integration of the smart algorithm as the datasheet implementation.
    The algorithm is used to extend the tracking acrocss a wider range of surfaces
    such as graniles and tiles.

config PMW3610_RUN_DOWNSHIFT_TIME_MS
    int "PMW3610's default RUN mode downshift time"
    default 128
    range 13 3264
    help
      Default RUN mode downshift down time in milliseconds.
      Time after which sensor goes from RUN to REST1 mode.

config PMW3610_REST1_DOWNSHIFT_TIME_MS
    int "PMW3610's default REST1 mode downshift time"
    default 5000
    help
      Default REST1 mode downshift down time in milliseconds.
      Time after which sensor goes from REST1 to REST2 mode.

config PMW3610_REST2_DOWNSHIFT_TIME_MS
    int "PMW3610's default REST2 mode downshift time"
    default 17000
    help
      Default REST2 mode downshift down time in milliseconds.
      Time after which sensor goes from REST2 to REST3 mode.

config PMW3610_REST1_SAMPLE_TIME_MS
    int "PMW3610's sample time in REST1 stage"
    default 40
    # range 10 2550
    help
      Default REST1 mode sample period in millisecond

config PMW3610_REST2_SAMPLE_TIME_MS
    int "PMW3610's sample time in REST2 stage"
    default 100
    # range 10 2550
    help
      Default REST2 mode sample period in millisecond.

config PMW3610_REST3_SAMPLE_TIME_MS
    int "PMW3610's sample time in REST3 stage"
    default 500
    # range 10 2550
    help
      Default REST2 mode sample period in millisecond.

config PMW3610_MACCEL
    bool "Enabled maccel"
    default n
    help
      Enables drive level mouse acceleration based on burkfers and Wimads keyboard mouse acceleration equation.
      Make sure to disable OS level mouse acceleration when using it

config PMW3610_MACCEL_TAKEOFF
    int "Mouse acceleration curve takes off more smoothly/abruptly, it will be divided by 100"
    default 200
    help
        The TAKEOFF variable controls how smoothly or abruptly the acceleration curve takes off.
        A higher value will make it take off more abruptly, a lower value smoothens out the start of the curve.

config PMW3610_MACCEL_GROWTH_RATE
    int "Mouse acceleration curve reaches its upper limit slower/faster, it will be divided by 100"
    default 025
    help
        The GROWTH_RATE variable sets the growth rate of the acceleration curve.
        A lower value will result in a flatter curve which takes longer to reach its LIMIT.
        A higher value will result in a steeper curve, which will reach its LIMIT faster.

config PMW3610_MACCEL_OFFSET
    int "Mouse acceleration acceleration kicks in earlier/later, it will be divided by 100"
    default 220
    help
        The OFFSET variable moves the entire curve towards the right. Offsetting the curve to the right 
        means acceleration will kick in later, which is useful for low speed precision - in effect what 
        you would otherwise have used SNIPING mode for. The maccel feature basically eliminates the 
        need for a sniping mode.

config PMW3610_MACCEL_LIMIT
    int "Mouse acceleration lower limit of accel curve (minimum acceleration factor)"
    default 020
    help
        The LIMIT variable sets the lower limit for the acceleration curve.
        This is the minimum acceleration factor at which the curve will start.
        In effect this adjusts the sensitivity for low speed precision movements.

config PMW3610_MACCEL_LIMIT_UPPER
    int "Mouse acceleration upper limit of accel curve (maximum acceleration factor), it will be divided by 100"
    default 100
    help
        The upper limit of the curve is fixed at 1, which means that at high speed sensitivity equals your default DPI. If you want to adjust high speed sensitivity, adjust your DPI.

config PMW3610_MACCEL_ROUNDING_CARRY_TIMEOUT_MS
    int "Mouse acceleration reset error correction"
    default 200
    help
        Milliseconds after which to reset quantization error correction (forget rounding remainder)

module = PMW3610
module-str = PMW3610
source "${ZEPHYR_BASE}/subsys/logging/Kconfig.template.log_config"

endif #PMW3610
```
